        tqt: tqt {
            compatible = "zmk,behavior-macro";
            #binding-cells = <0>;
            bindings =
                <&macro_tap>,
                <&kp APOS>,
                <&kp APOS>,
                <&kp APOS>;
        };

        shift: shift {
            compatible = "zmk,behavior-macro-one-param";
            #binding-cells = <1>;
            bindings =
                <&macro_press>,
                <&kp LSHIFT>,
                <&macro_tap>,
                <&macro_param_1to1 &kp MACRO_PLACEHOLDER>,
                <&macro_release>,
                <&kp LSHIFT>;
        };

        as: as {
            compatible = "zmk,behavior-macro-one-param";
            #binding-cells = <1>;
            bindings =
                <&macro_press>,
                <&macro_param_1to1 &macro_param_1to2 &as_ht MACRO_PLACEHOLDER MACRO_PLACEHOLDER>,
                <&macro_pause_for_release>,
                <&macro_release>,
                <&macro_param_1to1 &macro_param_1to2 &as_ht MACRO_PLACEHOLDER MACRO_PLACEHOLDER>;
        };
