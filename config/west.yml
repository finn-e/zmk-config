## config/west.yml
```yaml
manifest:
  defaults:
    revision: trunk
  remotes:
    - name: zmkfirmware
      url-base: https://github.com/zmkfirmware
    # Additional modules containing boards/shields/custom code can be listed here as well
    # See https://docs.zephyrproject.org/3.2.0/develop/west/manifest.html#projects
    - name: finn-e
      url-base: https://github.com/finn-e
  projects:
    - name: zmk
      remote: zmkfirmware
      revision: v0.3
      import: app/west.yml
    - name: zmk-keyboard-chocofi
      remote: finn-e
      revision: trunk
    - name: Typing-Keyboard2
      remote: finn-e
      revision: modulize
  self:
    path: config
```
